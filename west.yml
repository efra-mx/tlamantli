## west.yml
```yaml
# Copyright (c) 2021 Nordic Semiconductor ASA
# SPDX-License-Identifier: Apache-2.0

manifest:
  self:
    west-commands: scripts/west-commands.yml

  remotes:
    - name: zephyrproject-rtos
      url-base: https://github.com/zephyrproject-rtos
    - name: efra-mx
      url-base: https://github.com/efra-mx 

  projects:
    - name: zephyr
      remote: zephyrproject-rtos
      revision: main
      import:
        # By using name-allowlist we can clone only the modules that are
        # strictly needed by the application.
        name-allowlist:
          - cmsis      # required by the ARM port
          - hal_nordic # required by the custom_plank board (Nordic based)
          - mrf_hw_models
          - segger
          - mbedtls
          - net-tools
          - zbor
          - mcumgr
          - mcuboot
          - lz4
    - name: zephyr-ceedling
      revision: main
      remote: efra-mx
      repo-path: zephyr-ceedling
      path: test/zephyr-ceedling
      import: true

self:
  path: tlamantli
```
